## meta-robot-core/conf/layer.conf
```bitbake
BBPATH .= ":${LAYERDIR}"

BBFILES += "${LAYERDIR}/recipes-*/*/*.bb \
            ${LAYERDIR}/recipes-*/*/*.bbappend"

BBFILE_COLLECTIONS += "robot-core"
BBFILE_PATTERN_robot-core = "^${LAYERDIR}/"
BBFILE_PRIORITY_robot-core = "10"

LAYERDEPENDS_robot-core = "core openembedded-layer raspberrypi"
LAYERSERIES_COMPAT_robot-core = "scarthgap"
```
